## conf/layer.conf
```bitbake
# We have a conf and classes directory, add to BBPATH
BBPATH .= ":${LAYERDIR}"

# We have recipes-* directories, add to BBFILES
BBFILES += "${LAYERDIR}/recipes-*/*/*.bb \
        ${LAYERDIR}/recipes-*/*/*.bbappend"

BBFILE_COLLECTIONS += "afdc-routinely"
BBFILE_PATTERN_afdc-routinely = "^${LAYERDIR}/"
BBFILE_PRIORITY_afdc-routinely = "6"
```
